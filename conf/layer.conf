## conf/layer.conf
```bitbake
# We have a conf and classes directory, add to BBPATH
BBPATH .= ":${LAYERDIR}"

# We have recipes-* directories, add to BBFILES
BBFILES += "${LAYERDIR}/recipes-*/*/*.bb \
            ${LAYERDIR}/recipes-*/*/*.bbappend"

BBFILE_COLLECTIONS += "lsb"
BBFILE_PATTERN_lsb = "^${LAYERDIR}/"

LAYERDEPENDS_lsb = "core openembedded-layer perl-layer qt4-layer"
LAYERSERIES_COMPAT_lsb = "warrior zeus"

PREFERRED_PROVIDER_lsb-release ?= "lsb"
DISTROOVERRIDES ?= "linuxstdbase"
```
